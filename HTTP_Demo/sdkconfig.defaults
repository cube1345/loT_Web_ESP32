## HTTP_Demo/sdkconfig.defaults
```kconfig
CONFIG_ESP_HTTPS_SERVER_ENABLE=y
CONFIG_PARTITION_TABLE_SINGLE_APP_LARGE=y
CONFIG_EXAMPLE_CONNECT_WIFI=y
CONFIG_EXAMPLE_WIFI_SSID="SAST_2.4G"
CONFIG_EXAMPLE_WIFI_PASSWORD="sast_forever"
CONFIG_MBEDTLS_CERTIFICATE_BUNDLE=y
CONFIG_MBEDTLS_CERTIFICATE_BUNDLE_DEFAULT_FULL=y
```
